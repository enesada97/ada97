	;PIC 16F628A Kullanarak Sýralý LED Yakma
	;Bu kod Tuna Bulut tarafýndan yazýlmýþtýr.	
	
	LIST P=16F877A
	INCLUDE "P16F877A.INC"
;---------------------------------
;-------------DEÐÝÞKENLERÝ BÝR ADRESE ATA----------------
	CBLOCK	H'20'
	MEM						;MEM DEÐÝÞKENÝNÝ BÝR ADRESE ATA
	SAYAC1
	SAYAC2
	ENDC
	;-------------------------------------------------------- 
	MOVLW	H'07'
	MOVWF	CMCON   		;COMPARATOR ÖZELLÝÐÝ KAPALI VE PORTA I/O ÝÇÝN AKTÝF MODDA
	CLRF	PORTB    		;PORTB YÝ SIFIRLA
		
	;GÝRÝÞ-ÇIKIÞ TANIMLAMALARI
	
	BANKSEL	TRISA  		 ;BANK1 E GEÇÝÞ YAP	
	MOVLW	H'FF'	
	MOVWF	TRISA		;PORTA NIN BÜTÜN PÝNLERÝNÝ GÝRÝÞ YAP	
	CLRF 	TRISB		;PORTB NÝN BÜTÜN PÝNLERÝNÝ ÇIKIÞ YAP
	BANKSEL	PORTB		;TEKRAR BANK0 A GEÇ
	CLRF 	PORTB		;PORTB YÝ SIFIRLA

	MOVLW	H'01'
	MOVWF	MEM			;MEM DEÐÝÞKENÝNE H'01' DEÐERÝNÝ YÜKLE

	;ANA PROGRAM

KONTROL
	BTFSC	PORTA
	GOTO	KONTROL
YAK
	MOVF	MEM,W		;MEM DEÐÝÞKENÝNDEKÝ DEÐERÝ W YAZMACINA KAYDET
	MOVWF	PORTB		;W YAZMACINDAKÝ DEÐERÝ PORTB YE YÜKLE
KAYDIR
	RLF		MEM,1		;MEM DEÐÝÞKENÝNÝN DEÐERÝNÝ 1 SOLA KAYDIR VE MEM ÜZERÝNE KAYDET
	CALL	GECIKME		;GECIKME YÝ ÇAÐIR
	GOTO 	KONTROL		;KONTROL A GÝT

;-------------------195 MS LÝK GECÝKME(DELAY)----------------------------
GECIKME					
	MOVLW	H'FF'
	MOVWF	SAYAC1		;SAYAC1 E H'FF' DEÐERÝNÝ YÜKLE
DONGU1
	MOVLW	H'FF'
	MOVWF	SAYAC2		;SAYAC2 YE H'FF' DEÐERÝNÝ YÜKLE
DONGU2
	DECFSZ	SAYAC2,1	;SAYAC2 Ý 1 AZALT VE SAYAC2 ÜZERÝNE KAYDET 0 SA BÝR SONRAKÝ KOMUTU ATLA	
	GOTO	DONGU2
	DECFSZ	SAYAC1,1	;SAYAC1 Ý 1 AZALT VE SAYAC1 ÜZERÝNE KAYDET 0 SA BÝR SONRAKÝ KOMUTU ATLA	
	GOTO	DONGU1
	RETURN
;------------------------------------------------------------------------
	END					;KODUN BÝTÝMÝ 
